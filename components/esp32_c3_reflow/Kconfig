## components/esp32_c3_reflow/Kconfig
```kconfig
menu "Board Support Package"

    config BSP_ERROR_CHECK
        bool "Enable error check in BSP"
        default y
        help
            Error check assert the application before returning the error code.

    menu "Display"
        config BSP_DISPLAY_BRIGHTNESS_LEDC_CH
        int "LEDC channel index"
        default 1
        range 0 7
        help
            LEDC channel is used to generate PWM signal that controls display brightness.
            Set LEDC index that should be used.

        config BSP_LCD_DRAW_BUF_HEIGHT
        int "LCD framebuf height"
        default 20
        range 10 80
        help
            Framebuf is used for lvgl rendering output.

        config BSP_LCD_DRAW_BUF_DOUBLE
        bool "LCD double framebuf"
        default n
        help
            Whether to enable double framebuf.
    endmenu

endmenu
```

## sdkconfig.defaults
```kconfig
CONFIG_IDF_TARGET="esp32c3"

CONFIG_LV_COLOR_16_SWAP=y
CONFIG_LV_MEM_CUSTOM=y
CONFIG_LV_MEMCPY_MEMSET_STD=y

# CONFIG_LV_USE_OBSERVER=y
# CONFIG_LV_USE_SYSMON=y
# CONFIG_LV_USE_PERF_MONITOR=y

CONFIG_LV_ATTRIBUTE_FAST_MEM_USE_IRAM=y

CONFIG_LV_FONT_MONTSERRAT_8=y

# CONFIG_LV_USE_DEMO_WIDGETS=y
# CONFIG_LV_USE_DEMO_KEYPAD_AND_ENCODER=y
# CONFIG_LV_USE_DEMO_BENCHMARK=y

CONFIG_LV_DISP_DEF_REFR_PERIOD=30
CONFIG_LV_INDEV_DEF_READ_PERIOD=30

CONFIG_BSP_LCD_DRAW_BUF_HEIGHT=80
CONFIG_BSP_LCD_DRAW_BUF_DOUBLE=y

CONFIG_KNOB_PERIOD_TIME_MS=3
CONFIG_KNOB_DEBOUNCE_TICKS=2
CONFIG_KNOB_HIGH_LIMIT=2
CONFIG_KNOB_LOW_LIMIT=-2
```
